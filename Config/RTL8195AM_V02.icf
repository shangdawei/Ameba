// Functions ---------------------------------------------------------------------------------------
define exported symbol __rom_c_cut_text_start__ = 0x4467c;
define exported symbol __rom_c_cut_text_end__ = 0x49070;

define exported symbol HalInitPlatformLogUartV02 = 0x4467d;
define exported symbol HalReInitPlatformLogUartV02 = 0x4471d;
define exported symbol HalInitPlatformTimerV02 = 0x44755;
define exported symbol HalShowBuildInfoV02 = 0x447cd;
define exported symbol SpicReleaseDeepPowerDownFlashRtl8195A = 0x44831;
define exported symbol HalSpiInitV02 = 0x4488d;
define exported symbol HalBootFlowV02 = 0x44a29;
define exported symbol HalInitialROMCodeGlobalVarV02 = 0x44ae5;
define exported symbol HalResetVsrV02 = 0x44b41;
define exported symbol HalI2CSendRtl8195aV02 = 0x44ce1;
define exported symbol HalI2CSetCLKRtl8195aV02 = 0x44d59;
define exported symbol RtkI2CSendV02 = 0x4508d;
define exported symbol RtkI2CReceiveV02 = 0x459a1;
define exported symbol HalI2COpInitV02 = 0x461ed;
define exported symbol I2CISRHandleV02 = 0x463e9;
define exported symbol RtkSalI2COpInitV02 = 0x46be1;
define exported symbol SpicLoadInitParaFromClockRtl8195AV02 = 0x46c25;
define exported symbol SpiFlashAppV02 = 0x46c85;
define exported symbol SpicInitRtl8195AV02 = 0x46dc5;
define exported symbol SpicEraseFlashRtl8195AV02 = 0x46ea1;
define exported symbol HalTimerIrq2To7HandleV02 = 0x46f5d;
define exported symbol HalTimerIrqRegisterRtl8195aV02 = 0x46fe1;
define exported symbol HalTimerInitRtl8195aV02 = 0x4706d;
define exported symbol HalTimerReadCountRtl8195aV02 = 0x471b5;
define exported symbol HalTimerReLoadRtl8195aV02 = 0x471d1;
define exported symbol HalTimerIrqUnRegisterRtl8195aV02 = 0x4722d;
define exported symbol HalTimerDeInitRtl8195aV02 = 0x472c1;
define exported symbol HalTimerOpInitV02 = 0x472f9;
define exported symbol GPIO_LockV02 = 0x47345;
define exported symbol GPIO_UnLockV02 = 0x47379;
define exported symbol GPIO_Int_Clear_8195aV02 = 0x473a5;
define exported symbol HAL_GPIO_IntCtrl_8195aV02 = 0x473b5;
define exported symbol FindElementIndexV02 = 0x47541;
define exported symbol HalRuartInitRtl8195aV02 = 0x4756d;
define exported symbol DramInit_rom = 0x47619;
define exported symbol ChangeRandSeed_rom = 0x47979;
define exported symbol Sdr_Rand2_rom = 0x47985;
define exported symbol MemTest_rom = 0x479dd;
define exported symbol SdrCalibration_rom = 0x47a45;
define exported symbol SdrControllerInit_rom = 0x47d99;
define exported symbol SDIO_EnterCritical = 0x47e39;
define exported symbol SDIO_ExitCritical = 0x47e85;
define exported symbol SDIO_IRQ_Handler_Rom = 0x47ec5;
define exported symbol SDIO_Interrupt_Init_Rom = 0x47f31;
define exported symbol SDIO_Device_Init_Rom = 0x47f81;
define exported symbol SDIO_Interrupt_DeInit_Rom = 0x48215;
define exported symbol SDIO_Device_DeInit_Rom = 0x48255;
define exported symbol SDIO_Enable_Interrupt_Rom = 0x48281;
define exported symbol SDIO_Disable_Interrupt_Rom = 0x482a1;
define exported symbol SDIO_Clear_ISR_Rom = 0x482c1;
define exported symbol SDIO_Alloc_Rx_Pkt_Rom = 0x482d9;
define exported symbol SDIO_Free_Rx_Pkt_Rom = 0x48331;
define exported symbol SDIO_Recycle_Rx_BD_Rom = 0x48355;
define exported symbol SDIO_RX_IRQ_Handler_BH_Rom = 0x484f1;
define exported symbol SDIO_RxTask_Rom = 0x4851d;
define exported symbol SDIO_Process_H2C_IOMsg_Rom = 0x4856d;
define exported symbol SDIO_Send_C2H_IOMsg_Rom = 0x4859d;
define exported symbol SDIO_Process_RPWM_Rom = 0x485b5;
define exported symbol SDIO_Reset_Cmd_Rom = 0x485e9;
define exported symbol SDIO_Rx_Data_Transaction_Rom = 0x48611;
define exported symbol SDIO_Send_C2H_PktMsg_Rom = 0x48829;
define exported symbol SDIO_Register_Tx_Callback_Rom = 0x488f5;
define exported symbol SDIO_ReadMem_Rom = 0x488fd;
define exported symbol SDIO_WriteMem_Rom = 0x489a9;
define exported symbol SDIO_SetMem_Rom = 0x48a69;
define exported symbol SDIO_TX_Pkt_Handle_Rom = 0x48b29;
define exported symbol SDIO_TX_FIFO_DataReady_Rom = 0x48c69;
define exported symbol SDIO_IRQ_Handler_BH_Rom = 0x48d95;
define exported symbol SDIO_TxTask_Rom = 0x48e9d;
define exported symbol SDIO_TaskUp_Rom = 0x48eed;
define exported symbol SDIO_Boot_Up = 0x48f55;

// Constants ---------------------------------------------------------------------------------------
define exported symbol __rom_c_cut_rodata_start__ = 0x49070;
define exported symbol __rom_c_cut_rodata_end__ = 0x49314;

define exported symbol BAUDRATE_v02 = 0x49070;
define exported symbol OVSR_v02 = 0x490fc;
define exported symbol DIV_v02 = 0x49188;
define exported symbol OVSR_ADJ_v02 = 0x49214;
define exported symbol SdrDramInfo_rom = 0x492a0;
define exported symbol SdrDramTiming_rom = 0x492b4;
define exported symbol SdrDramModeReg_rom = 0x492e8;
define exported symbol SdrDramDev_rom = 0x49304;
